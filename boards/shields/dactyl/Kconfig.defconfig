## boards/shields/dactyl/Kconfig.defconfig
```kconfig
if SHIELD_DACTYL_DONGLE

	config ZMK_KEYBOARD_NAME 
		default "Dactyl Dongle"

	config ZMK_SPLIT_ROLE_CENTRAL
		default y

	config ZMK_SPLIT
		default y
endif

if SHIELD_DACTYL_LEFT || SHIELD_DACTYL_RIGHT
	
	config ZMK_SPLIT
		default y
endif
```
